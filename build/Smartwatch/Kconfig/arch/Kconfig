## build/Smartwatch/Kconfig/arch/Kconfig
```kconfig
# Load Zephyr Arch Kconfig descriptions.
osource "/home/luka/ncs/v2.9.1/zephyr/arch/x86/Kconfig"
osource "/home/luka/ncs/v2.9.1/zephyr/arch/xtensa/Kconfig"
osource "/home/luka/ncs/v2.9.1/zephyr/arch/sparc/Kconfig"
osource "/home/luka/ncs/v2.9.1/zephyr/arch/riscv/Kconfig"
osource "/home/luka/ncs/v2.9.1/zephyr/arch/posix/Kconfig"
osource "/home/luka/ncs/v2.9.1/zephyr/arch/nios2/Kconfig"
osource "/home/luka/ncs/v2.9.1/zephyr/arch/mips/Kconfig"
osource "/home/luka/ncs/v2.9.1/zephyr/arch/arm64/Kconfig"
osource "/home/luka/ncs/v2.9.1/zephyr/arch/arm/Kconfig"
osource "/home/luka/ncs/v2.9.1/zephyr/arch/arc/Kconfig"
```

## build/Smartwatch/Kconfig/boards/Kconfig.defconfig
```kconfig
# Load Zephyr board defconfig descriptions.
osource "/home/luka/ncs/v2.9.1/zephyr/boards/nordic/nrf52840dk/Kconfig.defconfig"
```

## build/Smartwatch/Kconfig/boards/Kconfig.nrf52840dk
```kconfig
# Load board Kconfig descriptions.
osource "/home/luka/ncs/v2.9.1/zephyr/boards/nordic/nrf52840dk/Kconfig.nrf52840dk"
```
